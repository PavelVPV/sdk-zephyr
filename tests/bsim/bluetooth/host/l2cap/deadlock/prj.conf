## prj.conf
```kconfig
CONFIG_BT=y
CONFIG_BT_EXT_ADV=y
CONFIG_BT_CTLR_DATA_LENGTH_MAX=251
CONFIG_BT_CTLR_ADV_DATA_LEN_MAX=191
CONFIG_SETTINGS=y
CONFIG_BT_CONN_TX_NOTIFY_WQ=n
CONFIG_FLASH=y
CONFIG_FLASH_MAP=y
CONFIG_BT_SETTINGS=y
CONFIG_NVS=y
CONFIG_BT_CENTRAL=y
CONFIG_BT_PERIPHERAL=y
CONFIG_BT_DEVICE_NAME="L2CAP stress test"

CONFIG_BT_EATT=n
CONFIG_BT_L2CAP_ECRED=n

CONFIG_BT_SMP=y # Next config depends on it
CONFIG_BT_L2CAP_DYNAMIC_CHANNEL=y

# Disable auto-initiated procedures so they don't
# mess with the test's execution.
CONFIG_BT_AUTO_PHY_UPDATE=n
CONFIG_BT_AUTO_DATA_LEN_UPDATE=n
CONFIG_BT_GAP_AUTO_UPDATE_CONN_PARAMS=n

# L2CAP MPS
# 23+27+27=77 makes exactly three full packets
CONFIG_BT_L2CAP_TX_MTU=77

# Use this to send L2CAP PDUs without any fragmentation.
# In this particular case, we prefer fragmenting to test that code path.
# CONFIG_BT_BUF_ACL_TX_SIZE=81

# L2CAP PDUs will be fragmented in 3 ACL packets.
CONFIG_BT_BUF_ACL_TX_SIZE=27

CONFIG_BT_BUF_ACL_TX_COUNT=2

# The minimum value for this is
# L2AP MPS + L2CAP header (4)
CONFIG_BT_BUF_ACL_RX_SIZE=81

# Governs BT_CONN_TX_MAX, and so must be >= than the max number of
# peers, since we attempt to send one SDU per peer. The test execution
# is a bit slowed down by having this at the very minimum, but we want
# to keep it that way as to stress the stack as much as possible.
CONFIG_BT_L2CAP_TX_BUF_COUNT=4

CONFIG_BT_CTLR_DATA_LENGTH_MAX=81
CONFIG_BT_CTLR_RX_BUFFERS=10

CONFIG_BT_MAX_CONN=1

CONFIG_LOG=y
CONFIG_ASSERT=y
CONFIG_NET_BUF_POOL_USAGE=y

# CONFIG_BT_L2CAP_LOG_LEVEL_DBG=y
# CONFIG_BT_CONN_LOG_LEVEL_DBG=y
CONFIG_LOG_THREAD_ID_PREFIX=y
CONFIG_THREAD_NAME=y

CONFIG_ARCH_POSIX_TRAP_ON_FATAL=y

# Must be enabled to reproduce the issue
#CONFIG_BT_HCI_ACL_FLOW_CONTROL=n
CONFIG_BT_HCI_ACL_FLOW_CONTROL=y

# Must be enabled to reproduce the issue
CONFIG_SOC_FLASH_NRF_PARTIAL_ERASE=y

# Since Flow Control is disabled, it doesn't matter which _RX_COUNT is increased as the max value is
# taken.

# >>>
# DEADLOCK_FLASH
# The following configuration never works with and without CONFIG_BT_CONN_TX_NOTIFY_WQ enabled:
#CONFIG_BT_CONN_TX_NOTIFY_WQ=y
#CONFIG_BT_BUF_ACL_RX_COUNT=2
#CONFIG_BT_BUF_EVT_RX_COUNT=2

# The following configuration works with CONFIG_BT_CONN_TX_NOTIFY_WQ enabled but doesn't work
# without it:
#CONFIG_BT_CONN_TX_NOTIFY_WQ=y
#CONFIG_BT_BUF_ACL_RX_COUNT=2
#CONFIG_BT_BUF_EVT_RX_COUNT=4
# <<<

# >>>
# DEADLOCK_HOST
CONFIG_BT_CONN_TX_NOTIFY_WQ=y
CONFIG_BT_BUF_ACL_RX_COUNT=2
CONFIG_BT_BUF_EVT_RX_COUNT=2
# <<<

CONFIG_BT_LL_SW_SPLIT=y
```

## src/main.c
```c
/*
 * Copyright (c) 2024 Nordic Semiconductor
 *
 * SPDX-License-Identifier: Apache-2.0
 */

#include "bstests.h"
#include "common.h"

#include "host/conn_internal.h"

#include <zephyr/settings/settings.h>
#include <zephyr/storage/flash_map.h>

#define LOG_MODULE_NAME main
#include <zephyr/logging/log.h>
LOG_MODULE_REGISTER(LOG_MODULE_NAME, LOG_LEVEL_DBG);

CREATE_FLAG(is_connected);
CREATE_FLAG(flag_l2cap_connected);

#define SDU_NUM          2000
#define SDU_LEN          27
#define RESCHEDULE_DELAY K_MSEC(100)
#define CHANNELS         4
#define FLASH_PAGE_SIZE  4096

/* Trigger deadlock in flash_sync_mpsl.c */
//#define DEADLOCK_FLASH
/* Trigger deadlock in host. */
#define DEADLOCK_HOST

static const struct flash_area *flash_area;

struct bt_conn *default_conn;

static void sdu_destroy(struct net_buf *buf)
{
	LOG_DBG("%p", buf);

	net_buf_destroy(buf);
}

static void rx_destroy(struct net_buf *buf)
{
	LOG_DBG("%p", buf);

	net_buf_destroy(buf);
}

/* Only one SDU per link will be transmitted at a time */
NET_BUF_POOL_DEFINE(sdu_tx_pool,
		    CONFIG_BT_MAX_CONN * CHANNELS, BT_L2CAP_SDU_BUF_SIZE(SDU_LEN),
		    CONFIG_BT_CONN_TX_USER_DATA_SIZE, sdu_destroy);

/* Only one SDU per link will be received at a time */
NET_BUF_POOL_DEFINE(sdu_rx_pool,
		    CONFIG_BT_MAX_CONN * CHANNELS, BT_L2CAP_SDU_BUF_SIZE(SDU_LEN),
		    8, rx_destroy);

static uint8_t tx_data[SDU_LEN];
static uint16_t rx_cnt;

struct test_ctx {
	struct k_work_delayable work_item;
	struct bt_l2cap_le_chan le_chan;
	size_t tx_left;
};

static struct test_ctx test_ctx[CHANNELS];

struct test_ctx *get_ctx(struct bt_l2cap_chan *chan)
{
	struct bt_l2cap_le_chan *le_chan = CONTAINER_OF(chan, struct bt_l2cap_le_chan, chan);
	struct test_ctx *ctx = CONTAINER_OF(le_chan, struct test_ctx, le_chan);

	return ctx;
}

int l2cap_chan_send(struct bt_l2cap_chan *chan, uint8_t *data, size_t len)
{
	LOG_DBG("chan %p conn %u data %p len %d", chan, bt_conn_index(chan->conn), data, len);

	struct net_buf *buf = net_buf_alloc(&sdu_tx_pool, K_NO_WAIT);

	if (buf == NULL) {
		FAIL("No more memory\n");
		return -ENOMEM;
	}

	net_buf_reserve(buf, BT_L2CAP_SDU_CHAN_SEND_RESERVE);
	net_buf_add_mem(buf, data, len);

	int ret = bt_l2cap_chan_send(chan, buf);

	if (ret == -EAGAIN) {
		LOG_DBG("L2CAP error %d, attempting to reschedule sending", ret);
		net_buf_unref(buf);
		k_work_reschedule(&(get_ctx(chan)->work_item), RESCHEDULE_DELAY);

		return ret;
	}

	if (ret < 0) {
		LOG_WRN("Failed sending: err %d", ret);
	} else {
		LOG_DBG("sent %d len %d", ret, len);
	}

	return ret;
}

struct net_buf *alloc_buf_cb(struct bt_l2cap_chan *chan)
{
	return net_buf_alloc(&sdu_rx_pool, K_NO_WAIT);
}

void continue_sending(struct test_ctx *ctx)
{
	struct bt_l2cap_chan *chan = &ctx->le_chan.chan;

	LOG_DBG("%p, left %d", chan, ctx->tx_left);

	if (ctx->tx_left) {
		l2cap_chan_send(chan, tx_data, sizeof(tx_data));
	} else {
		LOG_DBG("Done sending %u", bt_conn_index(chan->conn));
	}
}

void sent_cb(struct bt_l2cap_chan *chan)
{
	struct test_ctx *ctx = get_ctx(chan);

	LOG_DBG("%p", chan);

	if (ctx->tx_left) {
		ctx->tx_left--;
	}

	continue_sending(ctx);
}

int recv_cb(struct bt_l2cap_chan *chan, struct net_buf *buf)
{
	LOG_DBG("len %d", buf->len);
	rx_cnt++;

	/* Verify SDU data matches TX'd data. */
	int pos = memcmp(buf->data, tx_data, buf->len);

	if (pos != 0) {
		LOG_ERR("RX data doesn't match TX: pos %d", pos);
		LOG_HEXDUMP_ERR(buf->data, buf->len, "RX data");
		LOG_HEXDUMP_INF(tx_data, buf->len, "TX data");

		for (uint16_t p = 0; p < buf->len; p++) {
			__ASSERT(buf->data[p] == tx_data[p],
				 "Failed rx[%d]=%x != expect[%d]=%x",
				 p, buf->data[p], p, tx_data[p]);
		}
	}

#if defined(DEADLOCK_FLASH)
	/* Trigger timeout in flash_sync_mpsl.c */
	int err;

	/* This deadlock happens because hci_rx_pool is full, we hold the receive callback, which
	 * should release the buffer from the hci_rx_pool, the hci driver is waiting for a free
	 * buffer and flash erase with partial erase enabled is a long operation which partially
	 * relies on mpsl events executed from the same context which hci driver pushes data from
	 * the controller.
	 *
	 * More pages are erased, more hci_rx_pool should be to avoid deadlock.
	 */
	for (int i = 0; i < 2; i++) {
		err = flash_area_erase(flash_area, i * FLASH_PAGE_SIZE, FLASH_PAGE_SIZE);
		if (err) {
			FAIL("Failed to erase flash area (err %d)", err);
		}
	}
#elif defined(DEADLOCK_HOST)
	/* Trigger deadlock in host. */

	/* We need to call any random API which calls bt_hci_cmd_send_sync inside. This should
	 * result in Command Complete event from the controller which we will never receive because
	 * the hci_rx_pool is full and we are holding the buffer from being released by sitting here
	 * in the receive callback.
	 */
//	k_sleep(K_MSEC(10));
#if 1
	struct bt_conn_le_tx_power power_level = {0};
	int err;

	printk("Sleeping to fill up evt buffer\n");
#if 0
	for (int i = 0; i < 5; i++) {
		printk("[%d] Sleeping for 1s\n", i);
		k_sleep(K_SECONDS(1));
	}
#endif
	/* Sleep for a while to fill up the hci_rx_pool */
	k_sleep(K_MSEC(100));
//	k_sleep(K_SECONDS(60));

	printk("Triggering deadlock in host\n");

//	for (int i = 0; i < 5; i++) {
		err = bt_conn_le_get_tx_power_level(default_conn, &power_level);
		if (err) {
			FAIL("Failed to get tx power level (err %d)", err);
		}

		printf("Tx power level: %d\n", power_level.current_level);
//	}
#endif
#else
#error "No deadlock trigger defined"
#endif

	return 0;
}

void l2cap_chan_connected_cb(struct bt_l2cap_chan *l2cap_chan)
{
	struct bt_l2cap_le_chan *chan =
		CONTAINER_OF(l2cap_chan, struct bt_l2cap_le_chan, chan);

	SET_FLAG(flag_l2cap_connected);
	LOG_DBG("%x (tx mtu %d mps %d) (tx mtu %d mps %d)",
		l2cap_chan,
		chan->tx.mtu,
		chan->tx.mps,
		chan->rx.mtu,
		chan->rx.mps);
}

void l2cap_chan_disconnected_cb(struct bt_l2cap_chan *chan)
{
	UNSET_FLAG(flag_l2cap_connected);
	LOG_DBG("%p", chan);
}

static struct bt_l2cap_chan_ops ops = {
	.connected = l2cap_chan_connected_cb,
	.disconnected = l2cap_chan_disconnected_cb,
	.alloc_buf = alloc_buf_cb,
	.recv = recv_cb,
	.sent = sent_cb,
};

void deferred_send(struct k_work *item)
{
	struct test_ctx *ctx = CONTAINER_OF(k_work_delayable_from_work(item),
					    struct test_ctx, work_item);

	struct bt_l2cap_chan *chan = &ctx->le_chan.chan;

	LOG_DBG("continue %u left %d", bt_conn_index(chan->conn), ctx->tx_left);

	continue_sending(ctx);
}

struct test_ctx *alloc_test_context(void)
{
	static size_t ch;
	struct test_ctx *ctx = &test_ctx[ch];
	struct bt_l2cap_le_chan *le_chan = &ctx->le_chan;

	__ASSERT(le_chan->state == BT_L2CAP_DISCONNECTED,
		 "Channel is not in disconnected state");

	ch++;
	__ASSERT(ch <= CHANNELS, "No more available channels");

	memset(ctx, 0, sizeof(struct test_ctx));
	k_work_init_delayable(&ctx->work_item, deferred_send);

	return ctx;
}

int server_accept_cb(struct bt_conn *conn, struct bt_l2cap_server *server,
		     struct bt_l2cap_chan **chan)
{
	struct test_ctx *ctx;
	struct bt_l2cap_le_chan *le_chan;

	ctx = alloc_test_context();
	le_chan = &ctx->le_chan;

	memset(le_chan, 0, sizeof(*le_chan));
	le_chan->chan.ops = &ops;
	le_chan->rx.mtu = SDU_LEN;
	*chan = &le_chan->chan;

	return 0;
}

static struct bt_l2cap_server test_l2cap_server = {
	.accept = server_accept_cb
};

static int l2cap_server_register(bt_security_t sec_level)
{
	test_l2cap_server.psm = 0;
	test_l2cap_server.sec_level = sec_level;

	int err = bt_l2cap_server_register(&test_l2cap_server);

	ASSERT(err == 0, "Failed to register l2cap server.");

	return test_l2cap_server.psm;
}

static void connected(struct bt_conn *conn, uint8_t conn_err)
{
	char addr[BT_ADDR_LE_STR_LEN];

	bt_addr_le_to_str(bt_conn_get_dst(conn), addr, sizeof(addr));

	if (conn_err) {
		FAIL("Failed to connect to %s (%u)", addr, conn_err);
		return;
	}

	default_conn = conn;

	LOG_DBG("%s", addr);

	SET_FLAG(is_connected);
}

static void disconnected(struct bt_conn *conn, uint8_t reason)
{
	char addr[BT_ADDR_LE_STR_LEN];

	bt_addr_le_to_str(bt_conn_get_dst(conn), addr, sizeof(addr));

	LOG_ERR("%p %s (reason 0x%02x)", conn, addr, reason);

	UNSET_FLAG(is_connected);
}

BT_CONN_CB_DEFINE(conn_callbacks) = {
	.connected = connected,
	.disconnected = disconnected,
};

static void disconnect_device(struct bt_conn *conn, void *data)
{
	int err;

	SET_FLAG(is_connected);

	err = bt_conn_disconnect(conn, BT_HCI_ERR_REMOTE_USER_TERM_CONN);
	ASSERT(!err, "Failed to initate disconnect (err %d)", err);

	LOG_DBG("Waiting for disconnection...");
	WAIT_FOR_FLAG_UNSET(is_connected);
}

static void flash_work_handler(struct k_work *work);
static K_WORK_DEFINE(flash_work, flash_work_handler);

static void flash_work_handler(struct k_work *work)
{
	/* Trigger timeout in flash_sync_mpsl.c */
	int err;

	/* This deadlock happens because hci_rx_pool is full, we hold the receive callback, which
	 * should release the buffer from the hci_rx_pool, the hci driver is waiting for a free
	 * buffer and flash erase with partial erase enabled is a long operation which partially
	 * relies on mpsl events executed from the same context which hci driver pushes data from
	 * the controller.
	 *
	 * More pages are erased, more hci_rx_pool should be to avoid deadlock.
	 */
	err = flash_area_erase(flash_area, 0, FLASH_PAGE_SIZE);
	if (err) {
		FAIL("Failed to erase flash area (err %d)", err);
	}

	k_work_submit(&flash_work);
}

#define BT_LE_ADV_CONN_OT BT_LE_ADV_PARAM(BT_LE_ADV_OPT_CONNECTABLE | \
					  BT_LE_ADV_OPT_ONE_TIME,	\
					  BT_GAP_ADV_FAST_INT_MIN_2, \
					  BT_GAP_ADV_FAST_INT_MAX_2, NULL)

static void scan_cb(const bt_addr_le_t *addr, int8_t rssi,
		    uint8_t adv_type, struct net_buf_simple *buf)
{
#if 0
	LOG_WRN("rssi %d adv_type %u", rssi, adv_type);
	k_sleep(K_SECONDS(1));
//	k_sleep(K_MSEC(100));

//	if (adv_type != BT_GAP_ADV_TYPE_ADV_NONCONN_IND) {
//		return;
//	}

	LOG_HEXDUMP_DBG(buf->data, buf->len, "Recvd adv report");

	struct bt_conn_le_tx_power power_level = {0};
	int err;
	err = bt_conn_le_get_tx_power_level(default_conn, &power_level);
	if (err) {
		FAIL("Failed to get tx power level (err %d)", err);
	}

	printf("Tx power level: %d\n", power_level.current_level);
#endif
}

#define BT_MESH_ADV_SCAN_UNIT(_ms) ((_ms) * 8 / 5)

int scan_enable(void)
{
	struct bt_le_scan_param scan_param = {
		.type = BT_LE_SCAN_TYPE_PASSIVE,
		.interval = BT_MESH_ADV_SCAN_UNIT(30),
		.window = BT_MESH_ADV_SCAN_UNIT(30),
	};
	int err;

	LOG_DBG("");

	err = bt_le_scan_start(&scan_param, scan_cb);
	if (err && err != -EALREADY) {
		LOG_ERR("starting scan failed (err %d)", err);
		return err;
	}

	return 0;
}

static void test_dut_main(void)
{
	LOG_DBG("DUT deadlock started");
	int err;

	/* Prepare tx_data */
	for (size_t i = 0; i < sizeof(tx_data); i++) {
		tx_data[i] = (uint8_t)i;
	}

	err = bt_enable(NULL);
	if (err) {
		FAIL("Can't enable Bluetooth (err %d)", err);
		return;
	}

	(void)settings_load();

	err = flash_area_open(FIXED_PARTITION_ID(test_partition), &flash_area);
	if (err) {
		FAIL("Cannot open flash area (%d)", err);
	}

	LOG_DBG("DUT Bluetooth initialized.");
	LOG_DBG("Connectable advertising...");
	err = bt_le_adv_start(BT_LE_ADV_CONN_OT, NULL, 0, NULL, 0);
	if (err) {
		FAIL("Advertising failed to start (err %d)", err);
		return;
	}

	LOG_DBG("Advertising started.");
	LOG_DBG("DUT waiting for connection...");
	WAIT_FOR_FLAG_SET(is_connected);
	LOG_DBG("DUT is connected.");

	int psm = l2cap_server_register(BT_SECURITY_L1);

	LOG_DBG("Registered server PSM %x", psm);

	LOG_DBG("DUT waiting for L2CAP channels to connect...");
	for (size_t i = 0; i < CHANNELS; i++) {
		WAIT_FOR_FLAG_SET(flag_l2cap_connected);
		UNSET_FLAG(flag_l2cap_connected);
	}

	LOG_DBG("All L2CAP channels connected.");

	err = scan_enable();
	if (err) {
		FAIL("Scanning failed to start (err %d)", err);
		return;
	}

//	k_work_submit(&flash_work);

	LOG_DBG("DUT waiting for the transfer completion");
	do {
		k_msleep(100);
	} while (rx_cnt < SDU_NUM * CHANNELS);

	LOG_DBG("All packets received, disconnecting...");
	bt_conn_foreach(BT_CONN_TYPE_LE, disconnect_device, NULL);
	WAIT_FOR_FLAG_UNSET(is_connected);

	PASS("DUT deadlock test passed\n");
}

static void device_found(const bt_addr_le_t *addr, int8_t rssi, uint8_t type,
			 struct net_buf_simple *ad)
{
	struct bt_le_conn_param *param;
	struct bt_conn *conn;
	int err;

	err = bt_le_scan_stop();
	if (err) {
		FAIL("Stop LE scan failed (err %d)", err);
		return;
	}

	char str[BT_ADDR_LE_STR_LEN];

	bt_addr_le_to_str(addr, str, sizeof(str));

	LOG_DBG("Connecting to %s", str);

	param = BT_LE_CONN_PARAM_DEFAULT;
	err = bt_conn_le_create(addr, BT_CONN_LE_CREATE_CONN, param, &conn);
	if (err) {
		FAIL("Create conn failed (err %d)", err);
		return;
	}
}

static void connect_dut(void)
{
	struct bt_le_scan_param scan_param = {
		.type = BT_LE_SCAN_TYPE_ACTIVE,
		.options = BT_LE_SCAN_OPT_NONE,
		.interval = BT_GAP_SCAN_FAST_INTERVAL,
		.window = BT_GAP_SCAN_FAST_WINDOW,
	};

	UNSET_FLAG(is_connected);

	int err = bt_le_scan_start(&scan_param, device_found);

	ASSERT(!err, "Scanning failed to start (err %d)\n", err);

	LOG_DBG("Central initiating connection...");
	WAIT_FOR_FLAG_SET(is_connected);
}

static void connect_l2cap_channel(struct bt_conn *conn, void *data)
{
	for (size_t i = 0; i < CHANNELS; i++) {
		struct test_ctx *ctx = alloc_test_context();
		int err;

		ASSERT(ctx, "No more available test test_ctx\n");

		struct bt_l2cap_le_chan *le_chan = &ctx->le_chan;

		le_chan->chan.ops = &ops;
		le_chan->rx.mtu = SDU_LEN;

		LOG_DBG("Connecting L2CAP channel[%d] %p", i, &le_chan->chan);

		err = bt_l2cap_chan_connect(conn, &le_chan->chan, 0x0080);
		ASSERT(!err, "Error connecting l2cap channel (err %d)\n", err);

		WAIT_FOR_FLAG_SET(flag_l2cap_connected);
		UNSET_FLAG(flag_l2cap_connected);

		LOG_DBG("Connected L2CAP channel[%d] %p", i, &le_chan->chan);
	}
}

static void test_tester_main(void)
{
	int err;

	LOG_DBG("Tester deadlock started");

	/* Prepare tx_data */
	for (size_t i = 0; i < sizeof(tx_data); i++) {
		tx_data[i] = (uint8_t)i;
	}

	err = bt_enable(NULL);
	ASSERT(err == 0, "Can't enable Bluetooth (err %d)\n", err);
	LOG_DBG("Central Bluetooth initialized.");

	(void)settings_load();

	/* Connect to dut */
	connect_dut();

	/* Connect L2CAP channels */
	LOG_DBG("Connect L2CAP channels");
	bt_conn_foreach(BT_CONN_TYPE_LE, connect_l2cap_channel, NULL);

	LOG_DBG("All L2CAP channels connected.");

	k_sleep(K_SECONDS(2));

	/* Send SDU_NUM SDUs over each channel */
	for (size_t i = 0; i < CHANNELS; i++) {
		test_ctx[i].tx_left = SDU_NUM;
		l2cap_chan_send(&test_ctx[i].le_chan.chan, tx_data, sizeof(tx_data));
	}

	LOG_DBG("Wait until all transfers are completed.");
	int remaining_tx = 0;
	do {
		remaining_tx = 0;
		k_msleep(100);

		for (size_t i = 0; i < CHANNELS; i++) {
			remaining_tx += test_ctx[i].tx_left;
		}
	} while (remaining_tx || (rx_cnt < SDU_NUM * CHANNELS));

	LOG_DBG("Waiting until dut is disconnected..");
	WAIT_FOR_FLAG_UNSET(is_connected);

	PASS("Tester deadlock passed\n");
}

#define ADV_INT_FAST_MS    20
#define ADV_WORKQ_NUM_THREADS 1//(CONFIG_BT_BUF_CMD_TX_COUNT * 2)

static struct k_work_q adv_work_q[ADV_WORKQ_NUM_THREADS];
static K_THREAD_STACK_ARRAY_DEFINE(adv_work_stack, ADV_WORKQ_NUM_THREADS, 1024);
static struct k_work adv_work[ADV_WORKQ_NUM_THREADS];
static struct bt_le_ext_adv *adv_sets[ADV_WORKQ_NUM_THREADS];

static void adv_sent_cb(struct bt_le_ext_adv *instance, struct bt_le_ext_adv_sent_info *info)
{
	int i;
	int err;
	for (i = 0; i < ADV_WORKQ_NUM_THREADS; i++) {
		if (adv_sets[i] == instance) {
			break;
		}
	}
	__ASSERT_NO_MSG(i < ADV_WORKQ_NUM_THREADS);
	err = k_work_submit_to_queue(&adv_work_q[i], &adv_work[i]);
	if (err < 0) {
		FAIL("Failed to submit adv work[%d] (err: %d)", i, err);
	}
}

static int send_adv(struct bt_le_ext_adv *instance)
{
	int err;
	NET_BUF_SIMPLE_DEFINE(buf, 100);
	net_buf_simple_init(&buf, 0);

	net_buf_simple_add(&buf, 60);

	struct bt_le_ext_adv_start_param start = {
		.num_events = 1,
	};

	struct bt_data ad;
	ad.type = BT_DATA_MESH_MESSAGE;
	ad.data_len = buf.len;
	ad.data = buf.data;

	err = bt_le_ext_adv_set_data(instance, &ad, 1, NULL, 0);
	if (err) {
		LOG_ERR("Failed to set adv data (err: %d)", err);
		FAIL("");
		return err;
	}

	err = bt_le_ext_adv_start(instance, &start);
	if (err) {
		LOG_ERR("Failed to start adv (err: %d)", err);
		FAIL("");
		return err;
	}

	return 0;
}
static void adv_work_handler(struct k_work *work)
{
	int i;
	int err;

	i = ARRAY_INDEX(adv_work, work);
	err = send_adv(adv_sets[i]);
	if (err) {
		LOG_ERR("Failed to send adv (err: %d) from adv[%d], resubmitting", err, i);
		err = k_work_submit_to_queue(&adv_work_q[i], work);
		if (err < 0) {
			FAIL("Failed to resubmit adv work[%d] (err: %d)", i, err);
		}
	}
}
static void advertisers_setup(void)
{
	static const struct bt_le_ext_adv_cb adv_cb = { .sent = adv_sent_cb };
	struct bt_le_adv_param adv_param = {
		.id = BT_ID_DEFAULT,
		.options = BT_LE_ADV_OPT_EXT_ADV,
		.interval_min = BT_MESH_ADV_SCAN_UNIT(ADV_INT_FAST_MS),
		.interval_max = BT_MESH_ADV_SCAN_UNIT(ADV_INT_FAST_MS)
	};
	int err;
	for (int i = 0; i < ADV_WORKQ_NUM_THREADS; i++) {
		k_work_queue_start(&adv_work_q[i], adv_work_stack[i],
				   K_THREAD_STACK_SIZEOF(adv_work_stack[i]),
				   K_PRIO_COOP(1), NULL);
		k_thread_name_set(&adv_work_q[i].thread, "Test adv workq");
		k_work_init(&adv_work[i], adv_work_handler);
		err = bt_le_ext_adv_create(&adv_param, &adv_cb, &adv_sets[i]);
		if (err) {
			FAIL("Failed to create advertiser instance[%d] (err: %d)", i, err);
		}
	}
	for (int i = 0; i < ADV_WORKQ_NUM_THREADS; i++) {
		err = k_work_submit_to_queue(&adv_work_q[i], &adv_work[i]);
		if (err < 0) {
			FAIL("Failed to submit adv work[%d] (err: %d)", i, err);
		}
	}
}

static void test_tester_adv_main(void)
{
	int err;

	LOG_DBG("Tester deadlock started");

	/* Prepare tx_data */
	for (size_t i = 0; i < sizeof(tx_data); i++) {
		tx_data[i] = (uint8_t)i;
	}

	err = bt_enable(NULL);
	ASSERT(err == 0, "Can't enable Bluetooth (err %d)\n", err);
	LOG_DBG("Central Bluetooth initialized.");

	(void)settings_load();

	k_sleep(K_SECONDS(2));
	advertisers_setup();

	PASS("Tester adv deadlock passed\n");
}

static const struct bst_test_instance test_def[] = {
	{
		.test_id = "dut",
		.test_descr = "DUT acting as peripheral",
		.test_pre_init_f = test_init,
		.test_tick_f = test_tick,
		.test_main_f = test_dut_main
	},
	{
		.test_id = "tester",
		.test_descr = "Tester acting as central",
		.test_pre_init_f = test_init,
		.test_tick_f = test_tick,
		.test_main_f = test_tester_main
	},
	{
		.test_id = "tester_adv",
		.test_descr = "Tester acting as advertiser",
		.test_pre_init_f = test_init,
		.test_tick_f = test_tick,
		.test_main_f = test_tester_adv_main
	},
	BSTEST_END_MARKER
};

struct bst_test_list *test_main_l2cap_deadlock_install(struct bst_test_list *tests)
{
	return bst_add_tests(tests, test_def);
}

bst_test_install_t test_installers[] = {
	test_main_l2cap_deadlock_install,
	NULL
};

int main(void)
{
	bst_main();
	return 0;
}
```
