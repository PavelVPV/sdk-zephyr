## prj.conf
```kconfig
CONFIG_BT=y
CONFIG_BT_DEVICE_NAME="GATT tester"
CONFIG_BT_PERIPHERAL=y
CONFIG_BT_CENTRAL=y
CONFIG_BT_GATT_CLIENT=y

CONFIG_BT_GATT_AUTO_DISCOVER_CCC=y

CONFIG_BT_SMP=y
#CONFIG_BT_L2CAP_DYNAMIC_CHANNEL=y
#CONFIG_BT_L2CAP_ECRED=y
#CONFIG_BT_EATT=y

CONFIG_BT_AUTO_PHY_UPDATE=n
CONFIG_BT_AUTO_DATA_LEN_UPDATE=n

CONFIG_ASSERT=y
CONFIG_BT_TESTING=y
CONFIG_LOG=y

# Maximum possible EATT channels are used to parallelize notifications as much as possible,
# increasing traffic towards Central.
#CONFIG_BT_EATT_MAX=16

CONFIG_BT_ATT_TX_COUNT=16

# This is aligned with CONFIG_BT_EATT_MAX to utilize all EATT channels
CONFIG_BT_BUF_ACL_TX_COUNT=3

# Aligned with characteristic size
CONFIG_BT_BUF_ACL_RX_SIZE=247
CONFIG_BT_BUF_ACL_TX_SIZE=247
CONFIG_BT_L2CAP_TX_MTU=247

#CONFIG_BT_BUF_EVT_RX_COUNT=17
#CONFIG_BT_BUF_ACL_RX_COUNT_EXTRA=1

CONFIG_BT_BUF_CMD_TX_COUNT=2
```

## src/common.h
```c
/**
 * Common macros used by both sides of the test
 *
 * Copyright (c) 2025 Nordic Semiconductor ASA
 *
 * SPDX-License-Identifier: Apache-2.0
 */

#include <zephyr/toolchain.h>

#define CHRC_SIZE 238

#define TEST_SERVICE_UUID                                                                          \
	BT_UUID_DECLARE_128(0x01, 0x23, 0x45, 0x67, 0x89, 0x01, 0x02, 0x03, 0x04, 0x05, 0x06,      \
			    0x07, 0x08, 0x09, 0x00, 0x00)

#define TEST_CHRC_UUID                                                                             \
	BT_UUID_DECLARE_128(0x01, 0x23, 0x45, 0x67, 0x89, 0x01, 0x02, 0x03, 0x04, 0x05, 0x06,      \
			    0x07, 0x08, 0x09, 0xFF, 0x11)

#define NOTIFICATION_COUNT 300
```

## src/gatt_client_test.c
```c
/*
 * Copyright (c) 2025 Nordic Semiconductor ASA
 *
 * SPDX-License-Identifier: Apache-2.0
 */

#include <stddef.h>
#include <errno.h>

#include <zephyr/kernel.h>
#include <zephyr/types.h>
#include <zephyr/bluetooth/bluetooth.h>
#include <zephyr/bluetooth/hci.h>
#include <zephyr/bluetooth/conn.h>
#include <zephyr/bluetooth/uuid.h>
#include <zephyr/bluetooth/gatt.h>

#include "babblekit/testcase.h"
#include "babblekit/flags.h"
#include "common.h"

DEFINE_FLAG_STATIC(flag_is_connected);
DEFINE_FLAG_STATIC(flag_is_encrypted);
DEFINE_FLAG_STATIC(flag_discover_complete);
DEFINE_FLAG_STATIC(flag_long_subscribed);

static struct bt_conn *g_conn;
static uint16_t long_chrc_handle;
static const struct bt_uuid *test_svc_uuid = TEST_SERVICE_UUID;

static void connected(struct bt_conn *conn, uint8_t err)
{
	char addr[BT_ADDR_LE_STR_LEN];

	bt_addr_le_to_str(bt_conn_get_dst(conn), addr, sizeof(addr));

	if (err != 0) {
		TEST_FAIL("Failed to connect to %s (%u)", addr, err);
		return;
	}

	printk("Connected to %s\n", addr);

	SET_FLAG(flag_is_connected);
}

static void disconnected(struct bt_conn *conn, uint8_t reason)
{
	char addr[BT_ADDR_LE_STR_LEN];

	if (conn != g_conn) {
		return;
	}

	bt_addr_le_to_str(bt_conn_get_dst(conn), addr, sizeof(addr));

	printk("Disconnected: %s (reason 0x%02x)\n", addr, reason);

	bt_conn_unref(g_conn);

	g_conn = NULL;
	UNSET_FLAG(flag_is_connected);
}

void security_changed(struct bt_conn *conn, bt_security_t level, enum bt_security_err err)
{
	if (err) {
		TEST_FAIL("Encryption failure (%d)", err);
	} else if (level < BT_SECURITY_L2) {
		TEST_FAIL("Insufficient sec level (%d)", level);
	} else {
		SET_FLAG(flag_is_encrypted);
	}
}

BT_CONN_CB_DEFINE(conn_callbacks) = {
	.connected = connected,
	.disconnected = disconnected,
	.security_changed = security_changed,
};

void device_found(const bt_addr_le_t *addr, int8_t rssi, uint8_t type, struct net_buf_simple *ad)
{
	char addr_str[BT_ADDR_LE_STR_LEN];
	int err;

	if (g_conn != NULL) {
		return;
	}

	/* We're only interested in connectable events */
	if (type != BT_HCI_ADV_IND && type != BT_HCI_ADV_DIRECT_IND) {
		return;
	}

	bt_addr_le_to_str(addr, addr_str, sizeof(addr_str));
	printk("Device found: %s (RSSI %d)\n", addr_str, rssi);

	printk("Stopping scan\n");
	err = bt_le_scan_stop();
	if (err != 0) {
		TEST_FAIL("Could not stop scan: %d");
		return;
	}

	err = bt_conn_le_create(addr, BT_CONN_LE_CREATE_CONN, BT_LE_CONN_PARAM_DEFAULT, &g_conn);
	if (err != 0) {
		TEST_FAIL("Could not connect to peer: %d", err);
	}
}

static uint8_t discover_func(struct bt_conn *conn, const struct bt_gatt_attr *attr,
			     struct bt_gatt_discover_params *params)
{
	int err;

	if (attr == NULL) {
		if (long_chrc_handle == 0) {
			TEST_FAIL("Did not discover long_chrc (%x)", long_chrc_handle);
		}

		(void)memset(params, 0, sizeof(*params));

		SET_FLAG(flag_discover_complete);

		return BT_GATT_ITER_STOP;
	}

	printk("[ATTRIBUTE] handle %u\n", attr->handle);

	if (params->type == BT_GATT_DISCOVER_PRIMARY &&
	    bt_uuid_cmp(params->uuid, TEST_SERVICE_UUID) == 0) {
		printk("Found test service\n");
		params->uuid = NULL;
		params->start_handle = attr->handle + 1;
		params->type = BT_GATT_DISCOVER_CHARACTERISTIC;

		err = bt_gatt_discover(conn, params);
		if (err != 0) {
			TEST_FAIL("Discover failed (err %d)", err);
		}

		return BT_GATT_ITER_STOP;
	} else if (params->type == BT_GATT_DISCOVER_CHARACTERISTIC) {
		const struct bt_gatt_chrc *chrc = (struct bt_gatt_chrc *)attr->user_data;

		if (bt_uuid_cmp(chrc->uuid, TEST_CHRC_UUID) == 0) {
			printk("Found long_chrc\n");
			long_chrc_handle = chrc->value_handle;
		}
	}

	return BT_GATT_ITER_CONTINUE;
}

static void gatt_discover(enum bt_att_chan_opt opt)
{
	static struct bt_gatt_discover_params discover_params;
	int err;

	printk("Discovering services and characteristics\n");

	discover_params.uuid = test_svc_uuid;
	discover_params.func = discover_func;
	discover_params.start_handle = BT_ATT_FIRST_ATTRIBUTE_HANDLE;
	discover_params.end_handle = BT_ATT_LAST_ATTRIBUTE_HANDLE;
	discover_params.type = BT_GATT_DISCOVER_PRIMARY;

#if defined(CONFIG_BT_EATT)
	discover_params.chan_opt = opt;
#endif

	err = bt_gatt_discover(g_conn, &discover_params);
	if (err != 0) {
		TEST_FAIL("Discover failed(err %d)", err);
	}

	WAIT_FOR_FLAG(flag_discover_complete);
	printk("Discover complete\n");
}

static void test_long_subscribed(struct bt_conn *conn, uint8_t err,
				 struct bt_gatt_subscribe_params *params)
{
	if (err) {
		TEST_FAIL("Subscribe failed (err %d)", err);
	}

	SET_FLAG(flag_long_subscribed);

	if (!params) {
		printk("params NULL\n");
		return;
	}

	if (params->value_handle == long_chrc_handle) {
		printk("Subscribed to long characteristic\n");
	} else {
		TEST_FAIL("Unknown handle %d", params->value_handle);
	}
}

static volatile size_t num_notifications;
uint8_t test_notify(struct bt_conn *conn, struct bt_gatt_subscribe_params *params, const void *data,
		    uint16_t length)
{
	printk("Received notification #%u with length %d\n", num_notifications++, length);

	/* This causes ACL data drop in HCI IPC driver. */
	k_sleep(K_MSEC(10));

	struct bt_conn_le_tx_power power_level = {0};

	/* The auto-initiated procedure should generate enough events to occupy all buffers from
	 * the pool and cause a deadlock here as Command Complete upon getting the TX Power Level
	 * will not be received.
	 */
	int err = bt_conn_le_get_tx_power_level(conn, &power_level);
	TEST_ASSERT(err == 0, "Failed get tx power level (err %d)", err);

	printk("TX Power Level: %d dBm\n", power_level.current_level);

	return BT_GATT_ITER_CONTINUE;
}

static struct bt_gatt_discover_params disc_params_long;
static struct bt_gatt_subscribe_params sub_params_long = {
	.notify = test_notify,
	.subscribe = test_long_subscribed,
	.ccc_handle = BT_GATT_AUTO_DISCOVER_CCC_HANDLE,
	.disc_params = &disc_params_long,
	.end_handle = BT_ATT_LAST_ATTRIBUTE_HANDLE,
	.value = BT_GATT_CCC_NOTIFY,
};

static void gatt_subscribe_long(enum bt_att_chan_opt opt)
{
	int err;

	UNSET_FLAG(flag_long_subscribed);
	sub_params_long.value_handle = long_chrc_handle;
#if defined(CONFIG_BT_EATT)
	sub_params_long.chan_opt = opt;
#endif
	err = bt_gatt_subscribe(g_conn, &sub_params_long);
	if (err < 0) {
		TEST_FAIL("Failed to subscribe");
	} else {
		printk("Subscribe request sent\n");
	}
}

static void gatt_unsubscribe_long(enum bt_att_chan_opt opt)
{
	int err;

	UNSET_FLAG(flag_long_subscribed);
	sub_params_long.value_handle = long_chrc_handle;
#if defined(CONFIG_BT_EATT)
	sub_params_long.chan_opt = opt;
#endif
	err = bt_gatt_unsubscribe(g_conn, &sub_params_long);
	if (err < 0) {
		TEST_FAIL("Failed to unsubscribe");
	} else {
		printk("Unsubscribe request sent\n");
	}
}

static void att_mtu_updated(struct bt_conn *conn, uint16_t tx, uint16_t rx)
{
	printk("MTU updated: TX %u RX %u\n", tx, rx);
}

static struct bt_gatt_cb gatt_cb = {
	.att_mtu_updated = att_mtu_updated,
};

DEFINE_FLAG_STATIC(flag_mtu_exchange);

static void exchange_mtu_complete(struct bt_conn *conn, uint8_t err,
		     struct bt_gatt_exchange_params *params)
{
	if (err) {
		TEST_FAIL("MTU exchange failed (err %d)", err);
	} else {
		printk("MTU exchange completed\n");
	}

	SET_FLAG(flag_mtu_exchange);
}

static void setup(void)
{
	int err;

	err = bt_enable(NULL);
	if (err != 0) {
		TEST_FAIL("Bluetooth discover failed (err %d)", err);
	}

	bt_gatt_cb_register(&gatt_cb);

	err = bt_le_scan_start(BT_LE_SCAN_PASSIVE, device_found);
	if (err != 0) {
		TEST_FAIL("Scanning failed to start (err %d)", err);
	}

	printk("Scanning successfully started\n");

	WAIT_FOR_FLAG(flag_is_connected);

	err = bt_conn_set_security(g_conn, BT_SECURITY_L2);
	if (err) {
		TEST_FAIL("Starting encryption procedure failed (%d)", err);
	}

	WAIT_FOR_FLAG(flag_is_encrypted);

#if 0
	while (bt_eatt_count(g_conn) < CONFIG_BT_EATT_MAX) {
		k_sleep(K_MSEC(10));
	}

	printk("EATT connected\n");
#endif

	struct bt_gatt_exchange_params params = {
		.func = exchange_mtu_complete,
	};

	err = bt_gatt_exchange_mtu(g_conn, &params);
	if (err != 0) {
		TEST_FAIL("MTU exchange failed to start (err %d)", err);
	}

	WAIT_FOR_FLAG(flag_mtu_exchange);
}

static void test_main_client(void)
{
	setup();

	gatt_discover(BT_ATT_CHAN_OPT_ENHANCED_ONLY);
	gatt_subscribe_long(BT_ATT_CHAN_OPT_ENHANCED_ONLY);
	WAIT_FOR_FLAG(flag_long_subscribed);

	printk("Subscribed\n");

	while (num_notifications < NOTIFICATION_COUNT) {
		k_sleep(K_MSEC(100));
	}

	gatt_unsubscribe_long(BT_ATT_CHAN_OPT_ENHANCED_ONLY);
	WAIT_FOR_FLAG(flag_long_subscribed);

	printk("Unsubscribed\n");

	TEST_PASS("GATT client Passed");
}

static const struct bst_test_instance test_vcs[] = {
	{
		.test_id = "gatt_client_enhanced_notif_stress",
		.test_main_f = test_main_client,
	},
	BSTEST_END_MARKER,
};

struct bst_test_list *test_gatt_client_install(struct bst_test_list *tests)
{
	return bst_add_tests(tests, test_vcs);
}
```

## src/gatt_server_test.c
```c
/*
 * Copyright (c) 2025 Nordic Semiconductor ASA
 *
 * SPDX-License-Identifier: Apache-2.0
 */

#include <stddef.h>
#include <errno.h>

#include <zephyr/kernel.h>
#include <zephyr/types.h>
#include <zephyr/bluetooth/bluetooth.h>
#include <zephyr/bluetooth/hci.h>
#include <zephyr/bluetooth/conn.h>
#include <zephyr/bluetooth/uuid.h>
#include <zephyr/bluetooth/gatt.h>

#include "babblekit/testcase.h"
#include "babblekit/flags.h"
#include "common.h"

extern enum bst_result_t bst_result;

DEFINE_FLAG_STATIC(flag_is_connected);
DEFINE_FLAG_STATIC(flag_subscribe);

static struct bt_conn *g_conn;

#define ARRAY_ITEM(i, _) i
const uint8_t chrc_data[] = { LISTIFY(CHRC_SIZE, ARRAY_ITEM, (,)) }; /* 1, 2, 3 ... */

static void connected(struct bt_conn *conn, uint8_t err)
{
	char addr[BT_ADDR_LE_STR_LEN];

	bt_addr_le_to_str(bt_conn_get_dst(conn), addr, sizeof(addr));

	if (err != 0) {
		TEST_FAIL("Failed to connect to %s (%u)", addr, err);
		return;
	}

	printk("Connected to %s\n", addr);

	g_conn = bt_conn_ref(conn);
	SET_FLAG(flag_is_connected);
}

static void disconnected(struct bt_conn *conn, uint8_t reason)
{
	char addr[BT_ADDR_LE_STR_LEN];

	if (conn != g_conn) {
		return;
	}

	bt_addr_le_to_str(bt_conn_get_dst(conn), addr, sizeof(addr));

	printk("Disconnected: %s (reason 0x%02x)\n", addr, reason);

	bt_conn_unref(g_conn);

	g_conn = NULL;
	UNSET_FLAG(flag_is_connected);
}

BT_CONN_CB_DEFINE(conn_callbacks) = {
	.connected = connected,
	.disconnected = disconnected,
};

static ssize_t read_test_chrc(struct bt_conn *conn, const struct bt_gatt_attr *attr, void *buf,
				   uint16_t len, uint16_t offset)
{
	printk("Read char\n");
	return bt_gatt_attr_read(conn, attr, buf, len, offset, (void *)chrc_data,
				 sizeof(chrc_data));
}

static void subscribe(const struct bt_gatt_attr *attr, uint16_t value)
{
	const bool notif_enabled = (value == BT_GATT_CCC_NOTIFY);

	if (notif_enabled) {
		SET_FLAG(flag_subscribe);
	}

	printk("Notifications %s\n", notif_enabled ? "enabled" : "disabled");
}

BT_GATT_SERVICE_DEFINE(test_svc, BT_GATT_PRIMARY_SERVICE(TEST_SERVICE_UUID),
		       BT_GATT_CHARACTERISTIC(TEST_CHRC_UUID,
					      BT_GATT_CHRC_NOTIFY | BT_GATT_CHRC_READ,
					      BT_GATT_PERM_READ, read_test_chrc, NULL, NULL),
		       BT_GATT_CCC(subscribe, BT_GATT_PERM_READ | BT_GATT_PERM_WRITE));

static volatile size_t num_notifications_sent;

static void notification_sent(struct bt_conn *conn, void *user_data)
{
	size_t *length = user_data;

	printk("Sent notification #%u with length %d\n", num_notifications_sent++, *length);
}

static void notify(void)
{
	static size_t length = CHRC_SIZE;
	static struct bt_gatt_notify_params params = {
		.attr = &attr_test_svc[1],
		.data = chrc_data,
		.len = CHRC_SIZE,
		.func = notification_sent,
		.user_data = &length,
		.uuid = NULL,
#if defined(CONFIG_BT_EATT)
		.chan_opt = BT_ATT_CHAN_OPT_ENHANCED_ONLY,
#endif
	};
	int err;

	do {
		err = bt_gatt_notify_cb(g_conn, &params);

		if (err == -ENOMEM) {
			/* The delay is needed to schedule other threads, but keep it as short as
			 * possible.
			 */
			k_sleep(K_MSEC(1));
		} else if (err) {
			TEST_FAIL("Notify failed (err %d)", err);
		}
	} while (err);
}

DEFINE_FLAG_STATIC(flag_mtu_exchange);

static void att_mtu_updated(struct bt_conn *conn, uint16_t tx, uint16_t rx)
{
	printk("MTU updated: TX %u RX %u\n", tx, rx);
	SET_FLAG(flag_mtu_exchange);
}

static struct bt_gatt_cb gatt_cb = {
	.att_mtu_updated = att_mtu_updated,
};

static void setup(void)
{
	int err;
	const struct bt_data ad[] = {
		BT_DATA_BYTES(BT_DATA_FLAGS, (BT_LE_AD_GENERAL | BT_LE_AD_NO_BREDR)),
	};

	err = bt_enable(NULL);
	if (err != 0) {
		TEST_FAIL("Bluetooth init failed (err %d)", err);
		return;
	}

	printk("Bluetooth initialized\n");

	bt_gatt_cb_register(&gatt_cb);

	err = bt_le_adv_start(BT_LE_ADV_CONN_FAST_1, ad, ARRAY_SIZE(ad), NULL, 0);
	if (err != 0) {
		TEST_FAIL("Advertising failed to start (err %d)", err);
		return;
	}

	printk("Advertising successfully started\n");

	WAIT_FOR_FLAG(flag_is_connected);

#if 0
	while (bt_eatt_count(g_conn) < CONFIG_BT_EATT_MAX) {
		k_sleep(K_MSEC(100));
	}
	printk("EATT connected\n");
#endif
	WAIT_FOR_FLAG(flag_mtu_exchange);
	WAIT_FOR_FLAG(flag_subscribe);
}

static void test_main_server(void)
{
	setup();

	for (int i = 0; i < NOTIFICATION_COUNT; i++) {
		notify();
	}

	while (num_notifications_sent < NOTIFICATION_COUNT) {
		k_sleep(K_MSEC(100));
	}

	TEST_PASS("GATT server passed");
}

static const struct bst_test_instance test_gatt_server[] = {
	{
		.test_id = "gatt_server_enhanced_notif_stress",
		.test_main_f = test_main_server,
	},
	BSTEST_END_MARKER,
};

struct bst_test_list *test_gatt_server_install(struct bst_test_list *tests)
{
	return bst_add_tests(tests, test_gatt_server);
}
```
