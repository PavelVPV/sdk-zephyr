## prj.conf
```kconfig
CONFIG_TEST=y
CONFIG_TEST_LOGGING_DEFAULTS=n
#CONFIG_INIT_STACKS=y
CONFIG_MAIN_STACK_SIZE=2048
CONFIG_ISR_STACK_SIZE=1500
CONFIG_SYSTEM_WORKQUEUE_STACK_SIZE=3048
CONFIG_SHELL_STACK_SIZE=2200

CONFIG_SHELL=y
CONFIG_SHELL_CMD_BUFF_SIZE=128

CONFIG_BT_SETTINGS=y
CONFIG_FLASH=y
CONFIG_FLASH_MAP=y
CONFIG_NVS=y
CONFIG_SETTINGS=y

CONFIG_BT=y
CONFIG_BT_OBSERVER=y
CONFIG_BT_PERIPHERAL=y
CONFIG_BT_DEVICE_NAME="Zephyr Mesh"
CONFIG_BT_GATT_CACHING=n

CONFIG_BT_CTLR_DUP_FILTER_LEN=0
CONFIG_BT_CTLR_LE_ENC=n
CONFIG_BT_CTLR_LE_PING=n
CONFIG_BT_DATA_LEN_UPDATE=n
CONFIG_BT_PHY_UPDATE=n
CONFIG_BT_CTLR_MIN_USED_CHAN=n
CONFIG_BT_CTLR_PRIVACY=n
CONFIG_BT_CTLR_DTM_HCI=n
CONFIG_BT_CTLR_EXT_SCAN_FP=n
CONFIG_BT_DATA_LEN_UPDATE=n
CONFIG_BT_CTLR_PER_INIT_FEAT_XCHG=n
CONFIG_BT_CTLR_ADVANCED_FEATURES=y
CONFIG_BT_CTLR_FILTER_ACCEPT_LIST=n

CONFIG_BT_L2CAP_TX_BUF_COUNT=4

CONFIG_BT_MESH=y
CONFIG_BT_MESH_SHELL=y
CONFIG_BT_MESH_SHELL_HEALTH_SRV_INSTANCE=y
CONFIG_BT_MESH_SHELL_PROV_CTX_INSTANCE=y
CONFIG_BT_MESH_RELAY=y
CONFIG_BT_MESH_LOW_POWER=y
CONFIG_BT_MESH_LPN_AUTO=n
CONFIG_BT_MESH_FRIEND=y
CONFIG_BT_MESH_FRIEND_QUEUE_SIZE=16
CONFIG_BT_MESH_ADV_BUF_COUNT=9
CONFIG_BT_MESH_CFG_CLI=y
CONFIG_BT_MESH_CFG_CLI_TIMEOUT=6000
CONFIG_BT_MESH_HEALTH_CLI=y
CONFIG_BT_MESH_TX_SEG_MSG_COUNT=2
CONFIG_BT_MESH_RX_SEG_MSG_COUNT=2
CONFIG_BT_MESH_RX_SEG_MAX=32
CONFIG_BT_MESH_TX_SEG_MAX=32

CONFIG_BT_MESH_PB_GATT=y
CONFIG_BT_MESH_PB_ADV=y
CONFIG_BT_MESH_GATT_PROXY=y
CONFIG_BT_MESH_NODE_ID_TIMEOUT=10

CONFIG_BT_MESH_SUBNET_COUNT=2
CONFIG_BT_MESH_APP_KEY_COUNT=2
# PTS requires more key slots when using Opcodes Aggregator.
# First one is implicitly taken by Device Key.
CONFIG_BT_MESH_MODEL_KEY_COUNT=3
CONFIG_BT_MESH_MODEL_GROUP_COUNT=2
CONFIG_BT_MESH_LABEL_COUNT=1

CONFIG_LOG=y
CONFIG_LOG_BUFFER_SIZE=4000
CONFIG_LOG_PROCESS_THREAD_SLEEP_MS=250

CONFIG_BT_MESH_IV_UPDATE_TEST=y
CONFIG_BT_MESH_LOG_LEVEL_DBG=y
CONFIG_BT_MESH_CDB=y
CONFIG_BT_MESH_PROVISIONER=y
CONFIG_BT_MESH_STATISTIC=y

CONFIG_BT_MESH_RPR_SRV=y
CONFIG_BT_MESH_RPR_CLI=y
CONFIG_BT_MESH_MODEL_EXTENSIONS=y
```

## src/main.c
```c
/*
 * Copyright (c) 2017 Intel Corporation
 *
 * SPDX-License-Identifier: Apache-2.0
 */

#include <zephyr/sys/printk.h>
#include <stdlib.h>
#include <zephyr/kernel.h>

#include <zephyr/shell/shell.h>

#include <zephyr/bluetooth/bluetooth.h>
#include <zephyr/bluetooth/mesh.h>
#include <zephyr/bluetooth/mesh/shell.h>

static struct bt_mesh_cfg_cli cfg_cli;

#if defined(CONFIG_BT_MESH_DFD_SRV)
static struct bt_mesh_dfd_srv dfd_srv;
#endif

#if defined(CONFIG_BT_MESH_SAR_CFG_CLI)
static struct bt_mesh_sar_cfg_cli sar_cfg_cli;
#endif

#if defined(CONFIG_BT_MESH_PRIV_BEACON_CLI)
static struct bt_mesh_priv_beacon_cli priv_beacon_cli;
#endif

#if defined(CONFIG_BT_MESH_SOL_PDU_RPL_CLI)
static struct bt_mesh_sol_pdu_rpl_cli srpl_cli;
#endif


#if defined(CONFIG_BT_MESH_OD_PRIV_PROXY_CLI)
static struct bt_mesh_od_priv_proxy_cli od_priv_proxy_cli;
#endif

#if defined(CONFIG_BT_MESH_LARGE_COMP_DATA_CLI)
struct bt_mesh_large_comp_data_cli large_comp_data_cli;
#endif

#if defined(CONFIG_BT_MESH_BRG_CFG_CLI)
static struct bt_mesh_brg_cfg_cli brg_cfg_cli;
#endif

BT_MESH_SHELL_HEALTH_PUB_DEFINE(health_pub);

static const struct bt_mesh_model* root_models[] = {
	BT_MESH_MODEL_DECLARE(BT_MESH_MODEL_CFG_SRV),
	BT_MESH_MODEL_DECLARE(BT_MESH_MODEL_CFG_CLI(&cfg_cli)),
	BT_MESH_MODEL_DECLARE(BT_MESH_MODEL_HEALTH_SRV(&bt_mesh_shell_health_srv, &health_pub, health_srv_meta)),
	BT_MESH_MODEL_DECLARE(BT_MESH_MODEL_HEALTH_CLI(&bt_mesh_shell_health_cli)),
#if defined(CONFIG_BT_MESH_DFD_SRV)
	BT_MESH_MODEL_DFD_SRV(&dfd_srv),
#else
#if defined(CONFIG_BT_MESH_SHELL_DFU_SRV)
	BT_MESH_MODEL_DFU_SRV(&bt_mesh_shell_dfu_srv),
#elif defined(CONFIG_BT_MESH_SHELL_BLOB_SRV)
	BT_MESH_MODEL_BLOB_SRV(&bt_mesh_shell_blob_srv),
#endif
#if defined(CONFIG_BT_MESH_SHELL_DFU_CLI)
	BT_MESH_MODEL_DFU_CLI(&bt_mesh_shell_dfu_cli),
#elif defined(CONFIG_BT_MESH_SHELL_BLOB_CLI)
	BT_MESH_MODEL_BLOB_CLI(&bt_mesh_shell_blob_cli),
#endif
#endif /* CONFIG_BT_MESH_DFD_SRV */
#if defined(CONFIG_BT_MESH_SHELL_RPR_CLI)
	BT_MESH_MODEL_RPR_CLI(&bt_mesh_shell_rpr_cli),
#endif
#if defined(CONFIG_BT_MESH_RPR_SRV)
	BT_MESH_MODEL_DECLARE(BT_MESH_MODEL_RPR_SRV),
#endif

#if defined(CONFIG_BT_MESH_SAR_CFG_SRV)
	BT_MESH_MODEL_SAR_CFG_SRV,
#endif
#if defined(CONFIG_BT_MESH_SAR_CFG_CLI)
	BT_MESH_MODEL_SAR_CFG_CLI(&sar_cfg_cli),
#endif

#if defined(CONFIG_BT_MESH_OP_AGG_SRV)
	BT_MESH_MODEL_OP_AGG_SRV,
#endif
#if defined(CONFIG_BT_MESH_OP_AGG_CLI)
	BT_MESH_MODEL_OP_AGG_CLI,
#endif

#if defined(CONFIG_BT_MESH_LARGE_COMP_DATA_SRV)
	BT_MESH_MODEL_LARGE_COMP_DATA_SRV,
#endif
#if defined(CONFIG_BT_MESH_LARGE_COMP_DATA_CLI)
	BT_MESH_MODEL_LARGE_COMP_DATA_CLI(&large_comp_data_cli),
#endif

#if defined(CONFIG_BT_MESH_PRIV_BEACON_SRV)
	BT_MESH_MODEL_PRIV_BEACON_SRV,
#endif
#if defined(CONFIG_BT_MESH_PRIV_BEACON_CLI)
	BT_MESH_MODEL_PRIV_BEACON_CLI(&priv_beacon_cli),
#endif
#if defined(CONFIG_BT_MESH_OD_PRIV_PROXY_CLI)
	BT_MESH_MODEL_OD_PRIV_PROXY_CLI(&od_priv_proxy_cli),
#endif
#if defined(CONFIG_BT_MESH_SOL_PDU_RPL_CLI)
	BT_MESH_MODEL_SOL_PDU_RPL_CLI(&srpl_cli),
#endif
#if defined(CONFIG_BT_MESH_OD_PRIV_PROXY_SRV)
	BT_MESH_MODEL_OD_PRIV_PROXY_SRV,
#endif
#if defined(CONFIG_BT_MESH_BRG_CFG_SRV)
	BT_MESH_MODEL_BRG_CFG_SRV,
#endif
#if defined(CONFIG_BT_MESH_BRG_CFG_CLI)
	BT_MESH_MODEL_BRG_CFG_CLI(&brg_cfg_cli),
#endif
};

static const struct bt_mesh_elem elements[] = {
	BT_MESH_ELEM(0, root_models, BT_MESH_MODEL_PTR_LIST()),
};

static const struct bt_mesh_comp comp = {
	.cid = CONFIG_BT_COMPANY_ID,
	.elem = elements,
	.elem_count = ARRAY_SIZE(elements),
};

static void bt_ready(int err)
{
	if (err && err != -EALREADY) {
		printk("Bluetooth init failed (err %d)\n", err);
		return;
	}

	printk("Bluetooth initialized\n");

	err = bt_mesh_init(&bt_mesh_shell_prov, &comp);
	if (err) {
		printk("Initializing mesh failed (err %d)\n", err);
		return;
	}

	if (IS_ENABLED(CONFIG_SETTINGS)) {
		settings_load();
	}

	printk("Mesh initialized\n");

	if (bt_mesh_is_provisioned()) {
		printk("Mesh network restored from flash\n");
	} else {
		printk("Use \"prov pb-adv on\" or \"prov pb-gatt on\" to "
			    "enable advertising\n");
	}
}

int main(void)
{
	int err;

	printk("Initializing...\n");

	/* Initialize the Bluetooth Subsystem */
	err = bt_enable(bt_ready);
	if (err && err != -EALREADY) {
		printk("Bluetooth init failed (err %d)\n", err);
	}

	printk("Press the <Tab> button for supported commands.\n");
	printk("Before any Mesh commands you must run \"mesh init\"\n");
	return 0;
}
```

## src/le_pair_init.c
```c
/*
 * Copyright (c) 2023 Nordic Semiconductor ASA
 *
 * SPDX-License-Identifier: LicenseRef-Nordic-5-Clause
 */

#include "le_pair_init.h"
#include "../../../subsys/bluetooth/mesh/model_utils.h"
#include "mesh/access.h"

#define LOG_LEVEL CONFIG_BT_MESH_MODEL_LOG_LEVEL
#include "zephyr/logging/log.h"
LOG_MODULE_REGISTER(bt_mesh_le_pair_init);

#define BT_MESH_LE_PAIR_OP BT_MESH_MODEL_OP_3(0x11, BT_MESH_VENDOR_COMPANY_ID)

#define BT_MESH_LE_PAIR_OP_RESET 0x00
#define BT_MESH_LE_PAIR_OP_STATUS 0x01

#define STATUS_PASSKEY_SET 0x00
#define STATUS_PASSKEY_NOT_SET 0x01

static int handle_status(struct bt_mesh_model *model, struct bt_mesh_msg_ctx *ctx,
			 struct net_buf_simple *buf)
{
	struct bt_mesh_le_pair_init *cli = model->user_data;

	uint32_t passkey = 0;
	uint8_t status;

	if (buf->len != 4) {
		LOG_ERR("Invalid length: %d", buf->len);
		return -EINVAL;
	}

	status = net_buf_simple_pull_u8(buf);
	if (status == STATUS_PASSKEY_SET) {
		passkey = net_buf_simple_pull_le24(buf);
	}

	cli->passkey(cli, status == STATUS_PASSKEY_SET, passkey);

	return 0;
}

static int handle_op(struct bt_mesh_model *model, struct bt_mesh_msg_ctx *ctx,
		     struct net_buf_simple *buf)
{
	uint8_t op;

	op = net_buf_simple_pull_u8(buf);
	switch (op) {
	case BT_MESH_LE_PAIR_OP_STATUS:
		return handle_status(model, ctx, buf);
	default:
		LOG_WRN("Unknown opcode: %d", op);
	}

	return 0;
}

const struct bt_mesh_model_op _bt_mesh_le_pair_init_op[] = {
	{ BT_MESH_LE_PAIR_OP, BT_MESH_LEN_MIN(1), handle_op, },
	BT_MESH_MODEL_OP_END,
};

static int bt_mesh_le_pair_init_init(struct bt_mesh_model *model)
{
	struct bt_mesh_le_pair_init *cli = model->user_data;

	cli->model = model;

	return 0;
}

const struct bt_mesh_model_cb _bt_mesh_le_pair_init_cb = {
	.init = bt_mesh_le_pair_init_init,
};

int bt_mesh_le_pair_init_passkey_reset(struct bt_mesh_le_pair_init *cli,
					struct bt_mesh_msg_ctx *ctx)
{
	BT_MESH_MODEL_BUF_DEFINE(msg, BT_MESH_LE_PAIR_OP, 1);
	bt_mesh_model_msg_init(&msg, BT_MESH_LE_PAIR_OP);

	net_buf_simple_add_u8(&msg, BT_MESH_LE_PAIR_OP_RESET);

	return bt_mesh_model_send(cli->model, ctx, &msg, NULL, NULL);
}
```

## src/le_pair_init.h
```c
/*
 * Copyright (c) 2023 Nordic Semiconductor ASA
 *
 * SPDX-License-Identifier: LicenseRef-Nordic-5-Clause
 */

/**
 * @file
 * @defgroup bt_mesh_le_pair_init LE Pairing Initiator model
 * @{
 * @brief API for the LE Pairing Initiator model.
 */

#ifndef BT_MESH_LE_PAIR_INIT_H__
#define BT_MESH_LE_PAIR_INIT_H__

#ifdef __cplusplus
extern "C" {
#endif

#include <bluetooth/mesh/models.h>
#include <zephyr/bluetooth/addr.h>
#include <zephyr/bluetooth/mesh/access.h>

// FIXME: Collision with DM
#define BT_MESH_VENDOR_COMPANY_ID 0x0059
#define BT_MESH_MODEL_ID_LE_PAIR_INIT 0x000D

/** @def BT_MESH_MODEL_LE_PAIRING_INIT
 *
 * @brief LE Pairing Initiator model entry.
 *
 * @param[in] _srv Pointer to a @ref bt_mesh_dm_srv instance.
 */
#define BT_MESH_MODEL_LE_PAIR_INIT(_cli)                                                             \
	BT_MESH_MODEL_VND_CB(BT_MESH_VENDOR_COMPANY_ID, BT_MESH_MODEL_ID_LE_PAIR_INIT,             \
			     _bt_mesh_le_pair_init_op, NULL,                                       \
			 BT_MESH_MODEL_USER_DATA(struct bt_mesh_le_pair_init,     \
						 _cli),                        \
			     &_bt_mesh_le_pair_init_cb)

struct bt_mesh_le_pair_init {
	void (*passkey)(struct bt_mesh_le_pair_init *cli, bool status, uint32_t passkey);
	struct bt_mesh_model *model;
};

int bt_mesh_le_pair_init_passkey_reset(struct bt_mesh_le_pair_init *cli,
					struct bt_mesh_msg_ctx *ctx);

/** @cond INTERNAL_HIDDEN */

extern const struct bt_mesh_model_op _bt_mesh_le_pair_init_op[];
extern const struct bt_mesh_model_cb _bt_mesh_le_pair_init_cb;

/** @endcond */

#ifdef __cplusplus
}
#endif

#endif /* BT_MESH_LE_PAIR_INIT_H__ */

/** @} */
```

## src/smp_test.c
```c
/*
 * Copyright (c) 2023 Nordic Semiconductor ASA
 *
 * SPDX-License-Identifier: LicenseRef-Nordic-5-Clause
 */

#include <zephyr/init.h>

#include <zephyr/shell/shell.h>

/* .. include_startingpoint_mesh_smp_dfu_rst_1 */
#include <zephyr/bluetooth/bluetooth.h>
#include <zephyr/bluetooth/conn.h>
#include <zephyr/bluetooth/uuid.h>
#include <zephyr/bluetooth/gatt.h>

#include "le_pair_init.h"

#define TARGET_ADDR 0x000A

static struct bt_mesh_le_pair_init *le_pair_init;
static struct bt_conn *g_conn;
static struct bt_gatt_discover_params discover;

/* SMP service.
 * {8D53DC1D-1DB7-4CD3-868B-8A527460AA84}
 */
static struct bt_uuid_128 smp_bt_svc_uuid = BT_UUID_INIT_128(
	BT_UUID_128_ENCODE(0x8d53dc1d, 0x1db7, 0x4cd3, 0x868b, 0x8a527460aa84));

/* SMP characteristic; used for both requests and responses.
 * {DA2E7828-FBCE-4E01-AE9E-261174997C48}
 */
static struct bt_uuid_128 smp_bt_chr_uuid = BT_UUID_INIT_128(
	BT_UUID_128_ENCODE(0xda2e7828, 0xfbce, 0x4e01, 0xae9e, 0x261174997c48));

static struct bt_uuid_16 cccd = BT_UUID_INIT_16(BT_UUID_GATT_CCC_VAL);

static void scan_start(void);
static void scan_stop(void);

static uint32_t g_passkey;

static struct bt_gatt_read_params read_params;

static bool g_req_auth = true;

static void passkey_cb(struct bt_mesh_le_pair_init *mod, bool status, uint32_t passkey)
{
	int err;

	printk("Passkey received %s: %u\n", status ? "succ" : "NOT succ", passkey);

	if (!status) {
		(void)bt_conn_auth_cancel(g_conn);
		return;
	}

	if (!g_conn) {
		printk("Uknown connection!\n");
		return;
	}

	g_passkey = passkey;

	/* Attempt to read characteristic should trigger pairing request. */
	err = bt_gatt_read(g_conn, &read_params);
	if (err) {
		printk("CCCD read failed (err %d)\n", err);
	}
}

static void cancel(struct bt_conn *conn)
{
	printk("%s:%d\n", __func__, __LINE__);
}

static void pairing_confirm(struct bt_conn *conn)
{
	int err;

	printk("%s:%d\n", __func__, __LINE__);

	err = bt_conn_auth_pairing_confirm(conn);
	if (err) {
		printf("Can't confirm pairing (err: %d)\n", err);
	}
}

static void passkey_entry(struct bt_conn *conn)
{
	int err;

	err = bt_conn_auth_passkey_entry(g_conn, g_passkey);
	if (err) {
		printk("Failed to set passkey: %d\n", err);
		bt_conn_auth_cancel(conn);
	}
}

static enum bt_security_err pairing_accept(struct bt_conn *conn,
					   const struct bt_conn_pairing_feat *const feat)
{
	if (conn != g_conn) {
		printk("Pairing request from unknown connection (%p), expected from (%p)", conn,
		       g_conn);
		return BT_SECURITY_ERR_UNSPECIFIED;
	}

	return BT_SECURITY_ERR_SUCCESS;
}

static struct bt_conn_auth_cb auth_cb = {
	.pairing_accept = pairing_accept,
	.passkey_entry = passkey_entry,
	.cancel = cancel,
	.pairing_confirm = pairing_confirm,
};

static void pairing_complete(struct bt_conn *conn, bool bonded)
{
	printk("Pairing complete\n");

	scan_start();
}

static void pairing_failed(struct bt_conn *conn, enum bt_security_err reason)
{
	printk("Pairing failed\n");

	scan_start();
}

static struct bt_conn_auth_info_cb conn_auth_info_callbacks = {
	.pairing_complete = pairing_complete,
	.pairing_failed = pairing_failed
};

static uint8_t read_func(struct bt_conn *conn, uint8_t err,
			 struct bt_gatt_read_params *params,
			 const void *data, uint16_t length)
{
	printk("Read error code: %d\n", err);

	return BT_GATT_ITER_STOP;
}

static uint8_t discover_func(struct bt_conn *conn,
			     const struct bt_gatt_attr *attr,
			     struct bt_gatt_discover_params *params)
{
	int err;

	if (!attr) {
		printk("GATT Services Discover complete\nh");
		(void)memset(params, 0, sizeof(*params));
		return BT_GATT_ITER_STOP;
	}

	if (!bt_uuid_cmp(discover.uuid, (struct bt_uuid *)&smp_bt_svc_uuid)) {
		printk("SMP Service discovered\n");
		discover.uuid = (struct bt_uuid *)&smp_bt_chr_uuid;
		discover.start_handle = attr->handle + 1;
		discover.type = BT_GATT_DISCOVER_CHARACTERISTIC;

		err = bt_gatt_discover(conn, &discover);
		if (err) {
			printk("Discover GATT data in char failed (err %d)\n", err);
		}
	} else if (!bt_uuid_cmp(discover.uuid, (struct bt_uuid *)&smp_bt_chr_uuid)) {
		printk("SMP Characteristic discovered\n");

		discover.uuid = (struct bt_uuid *)&cccd;
		discover.start_handle = attr->handle + 2;
		discover.type = BT_GATT_DISCOVER_DESCRIPTOR;

		err = bt_gatt_discover(conn, &discover);
		if (err) {
			printk("Discover GATT CCCD failed (err %d)\n", err);
		}
	} else if (!bt_uuid_cmp(discover.uuid, (struct bt_uuid *)&cccd)) {
		printk("SMP CCCD discovered\n");

		/* Prepare read params */
		read_params.func = read_func;
		read_params.handle_count = 1;
		read_params.single.handle = attr->handle;

		struct bt_mesh_msg_ctx ctx = BT_MESH_MSG_CTX_INIT_APP(0, TARGET_ADDR);

		if (g_req_auth) {
			/* Ready to request the passkey. */
			err = bt_mesh_le_pair_init_passkey_reset(le_pair_init, &ctx);
			if (err) {
				printk("Failed to request passkey: %d\n", err);
			} else {
				printk("Waiting for the passkey from another device...\n");
			}
		} else {
			/* Attempt to read characteristic should trigger pairing request. */
			err = bt_gatt_read(g_conn, &read_params);
			if (err) {
				printk("CCCD read failed (err %d)\n", err);
			}
		}
	}

	return BT_GATT_ITER_STOP;
}

static void gatt_connected(struct bt_conn *conn, uint8_t conn_err)
{
	struct bt_conn_info info;
	int err;

	printk("conn %p err 0x%02x\n", (void *)conn, conn_err);

	bt_conn_get_info(conn, &info);
	if (info.role != BT_CONN_ROLE_CENTRAL || conn != g_conn) {
		return;
	}

	/* Restore mesh scanning after connecting. */
	err = bt_mesh_scan_enable();
	if (err) {
		printk("Unable to start mesh scan again: %d\n", err);
	}

	if (conn_err) {
		printk("Failed to connect GATT Services(%u)\n", conn_err);

		bt_conn_unref(g_conn);

		scan_start();
		return;
	}

	discover.uuid = (struct bt_uuid *)&smp_bt_svc_uuid;
	discover.func = discover_func;
	discover.start_handle = BT_ATT_FIRST_ATTRIBUTE_HANDLE;
	discover.end_handle = BT_ATT_LAST_ATTRIBUTE_HANDLE;
	discover.type = BT_GATT_DISCOVER_PRIMARY;
	err = bt_gatt_discover(conn, &discover);
	if (err) {
		printk("Unable discover GATT Services (err %d)\n", err);
	}
}

static void gatt_disconnected(struct bt_conn *conn, uint8_t reason)
{
	struct bt_conn_info info;

	printk("dis conn %p reason 0x%02x\n", (void *)conn, reason);

	bt_conn_get_info(conn, &info);
	if (info.role != BT_CONN_ROLE_CENTRAL || g_conn != conn) {
		return;
	}

	bt_conn_unref(g_conn);
}

static int gatt_connect(const bt_addr_le_t *addr)
{
	int err;

	err = bt_mesh_scan_disable();
	if (err) {
		printk("Unable to stop mesh scan: %d\n", err);
		return err;
	}

	err = bt_conn_le_create(addr, BT_CONN_LE_CREATE_CONN,
				BT_LE_CONN_PARAM_DEFAULT, &g_conn);
	if (err) {
		printk("Connection start failed (err:%d)\n", err);
	}

	return err;
}

static void device_found(const struct bt_le_scan_recv_info *info)
{
	char addr[BT_ADDR_LE_STR_LEN];

	bt_addr_le_to_str(info->addr, addr, sizeof(addr));

	if (!bt_mesh_is_provisioned() ||
	    NULL == bt_mesh_cdb_node_get(TARGET_ADDR)) {
		printk("Device %s found, but not provisioned yet\n", addr);
		return;
	}

	printk("Connecting to %s\n", addr);

	scan_stop();
	gatt_connect(info->addr);
}

static void scan_recv(const struct bt_le_scan_recv_info *info,
		      struct net_buf_simple *buf)
{
	if (info->adv_type != BT_GAP_ADV_TYPE_ADV_IND) {
		return;
	}

	while (buf->len > 1) {
		struct net_buf_simple_state state;
		uint8_t len, type;

		len = net_buf_simple_pull_u8(buf);
		/* Check for early termination */
		if (len == 0U) {
			return;
		}

		if (len > buf->len) {
			printk("AD malformed\n");
			return;
		}

		net_buf_simple_save(buf, &state);

		type = net_buf_simple_pull_u8(buf);

		buf->len = len - 1;

		switch (type) {
		case BT_DATA_UUID128_ALL:
			if (buf->len == 16 &&
			    !memcmp(buf->data, smp_bt_svc_uuid.val, 16)) {
				device_found(info);
				return;
			}
			break;
#if 0
		case BT_DATA_NAME_COMPLETE:
			const uint8_t name[] = "Mesh DFU Distributor";

			if (!memcmp(name, buf->data, MIN(len, strlen(name)))) {
				device_found(info);
				return;
			}
			break;
#endif
		default:
			break;
		}

		net_buf_simple_restore(buf, &state);
		net_buf_simple_pull(buf, len);
	}
}

static struct bt_le_scan_cb scan_cb = {
	.recv = scan_recv,
};

static void scan_start(void)
{
	printk("Scanning started\n");
	bt_le_scan_cb_register(&scan_cb);
//	bt_mesh_scan_active_set(true);
}

static void scan_stop(void)
{
	printk("Scanning stopped\n");
	bt_le_scan_cb_unregister(&scan_cb);
//	bt_mesh_scan_active_set(false);
}

BT_CONN_CB_DEFINE(conn_callbacks) = {
	.connected = gatt_connected,
	.disconnected = gatt_disconnected,
};

static int cmd_scan_start(const struct shell *sh, size_t argc, char *argv[])
{
	int err;

	if (argc > 1) {
		g_req_auth = shell_strtobool(argv[1], 0, &err);
	}

	scan_start();
	return 0;
}

SHELL_STATIC_SUBCMD_SET_CREATE(smp_cmds,
	SHELL_CMD_ARG(scan-start, NULL, NULL, cmd_scan_start, 1, 1),
	SHELL_SUBCMD_SET_END
);

SHELL_CMD_ARG_REGISTER(smp, &smp_cmds, "SMP test shell commands", NULL, 1, 1);

int smp_bt_auth_init(struct bt_mesh_le_pair_init *mod)
{
	int err;

	err = bt_conn_auth_cb_register(&auth_cb);
	if (err) {
		printk("Can't reg bt conn auth cb (err: %d)\n", err);
		return err;
	}

	err = bt_conn_auth_info_cb_register(&conn_auth_info_callbacks);
	if (err) {
		printk("Can't reg auth info cb (err: %d)\n", err);
		return err;
	}

	le_pair_init = mod;
	le_pair_init->passkey = passkey_cb;

	return 0;
}
```
