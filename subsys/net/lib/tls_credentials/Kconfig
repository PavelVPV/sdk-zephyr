## subsys/net/lib/tls_credentials/Kconfig
```kconfig
# Copyright (c) 2018 Nordic Semiconductor ASA
# SPDX-License-Identifier: Apache-2.0

menuconfig TLS_CREDENTIALS
	bool "TLS credentials management"
	help
	  Enable TLS credentials management subsystem.

if TLS_CREDENTIALS

module = TLS_CREDENTIALS
module-str = tls_credentials
source "subsys/logging/Kconfig.template.log_config"

choice TLS_CREDENTIALS_BACKEND
	prompt "TLS credentials management backend"
	depends on TLS_CREDENTIALS
	default TLS_CREDENTIALS_BACKEND_VOLATILE
	help
	  TLS credentials management backend implementation.

config TLS_CREDENTIALS_BACKEND_VOLATILE
	bool "TLS credentials management volatile backend"
	help
	  TLS credentials management volatile backend implementation,
	  storing credentials in system runtime memory.

config TLS_CREDENTIALS_BACKEND_PROTECTED_STORAGE
	bool "TLS credentials management protected storage backend"
	depends on BUILD_WITH_TFM || SECURE_STORAGE
	select PSA_WANT_ALG_SHA_256
	# This backend builds storage UIDs that use the full 64-bit range
	# (see tls_credential_get_uid()). TF-M's Protected Storage supports that
	# natively, but Zephyr's Secure Storage defaults to a 30-bit UID, so the
	# 64-bit UID range must be enabled there for psa_ps_set() to accept them.
	select SECURE_STORAGE_64_BIT_UID if SECURE_STORAGE
	help
	  TLS credentials management backend using the Protected Storage
	  API to store credentials with integrity check against physical
	  attacks and keeps entries across system reboot.

endchoice

config TLS_MAX_CREDENTIALS_NUMBER
	int "Maximum number of TLS credentials"
	default 4
	help
	  Maximum number of TLS credentials that can be registered.

config TLS_CREDENTIAL_FILENAMES
	bool "Specify TLS credential filenames"
	depends on NET_SOCKETS_OFFLOAD
	help
	  Allows clients of the socket APIs to specify filenames
	  of security certificates and private keys
	  to use during subsequent TLS/SSL negotiations.
	  The secure files will have been previously provisioned to the
	  device's secure file system; eg, via a vendor tool or
	  by executing a separate binary.
	  This option is currently only available for secure
	  socket offload devices.

config TLS_CREDENTIALS_KEYGEN
	bool "On-device private key and CSR generation [EXPERIMENTAL]"
	select EXPERIMENTAL
	select MBEDTLS
	select MBEDTLS_PK_PARSE_C
	select MBEDTLS_PK_WRITE_C
	select MBEDTLS_X509_CSR_WRITE_C
	select PSA_WANT_KEY_TYPE_ECC_KEY_PAIR_GENERATE
	select PSA_WANT_KEY_TYPE_ECC_PUBLIC_KEY
	select PSA_WANT_ALG_ECDSA
	select PSA_WANT_ALG_SHA_256
	select PSA_WANT_ECC_SECP_R1_256
	help
	  Generate a TLS device private key on the device using the PSA Crypto API. The key is a
	  persistent, non-exportable ECC P-256 key and is referenced for TLS by its PSA key ID
	  (TLS_CREDENTIAL_PRIVATE_KEY_PSA), so the private key never leaves the device. A
	  Certificate Signing Request (CSR) signed by the key can be generated for a certificate
	  authority. The key must be registered with the TLS credentials module after every
	  boot, see tls_credentials_key_restore().

config TLS_CREDENTIALS_KEYGEN_VERIFY
	bool "Export the on-device public key for verification"
	depends on TLS_CREDENTIALS_KEYGEN
	default y
	help
	  Provide an API to export the public key of the on-device key pair. The private key is
	  non-exportable, so host tools use the public key to verify that the on-device key
	  matches the installed device certificate. Disable to save a small amount of code.

source "subsys/net/lib/tls_credentials/Kconfig.shell"

endif # TLS_CREDENTIALS
```

## tests/net/lib/tls_credentials_keygen/testcase.yaml
```yaml
tests:
  net.tls_credentials.keygen:
    platform_allow:
      - native_sim
    integration_platforms:
      - native_sim
    tags:
      - net
      - tls_credentials
```
